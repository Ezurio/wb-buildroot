## boot/ti-k3-boot-firmware/Config.in
```kconfig
config BR2_TARGET_TI_K3_BOOT_FIRMWARE
	bool "ti-k3-boot-firmware"
	depends on BR2_aarch64
	help
	  This package downloads and installs the TI-specific ti-sysfw
	  and ti-dm firmware needed to boot TI K3 platforms (which
	  include AM62x, AM64x, AM65x, AM67x and more).

if BR2_TARGET_TI_K3_BOOT_FIRMWARE

config BR2_TARGET_TI_K3_BOOT_FIRMWARE_CPU
	string "cpu type"
	default "am62xx"
	help
	  This package downloads and installs the TI-specific sysfw
	  firmware needed to boot TI K3 platforms

config BR2_TARGET_TI_K3_BOOT_FIRMWARE_VPU
	bool "VPU firmware"
	help
	  This package downloads and installs the TI-specific VPU firmware

config BR2_TARGET_TI_K3_BOOT_FIRMWARE_MCU_DEMO
	bool "MCU demo firmware"
	help
	  This package downloads and installs the TI-specific MCU demo firmware

endif
```

## package/freescale-imx/firmware-imx/Config.in
```kconfig
config BR2_PACKAGE_FIRMWARE_IMX
	bool "firmware-imx"
	depends on BR2_arm || BR2_aarch64 # Only relevant for i.MX
	help
	  Firmware blobs for the Freescale i.MX SoCs.

	  It contains blobs for SDMA, VPU, HDMI, EDPC, and DDR
	  training.

	  This library is provided by Freescale as-is and doesn't have
	  an upstream.

if BR2_PACKAGE_FIRMWARE_IMX

config BR2_PACKAGE_FIRMWARE_IMX_SDMA_FW_NAME
	string
	default "imx25" if BR2_PACKAGE_FREESCALE_IMX_PLATFORM_IMX25_3STACK
	default "imx51" if BR2_PACKAGE_FREESCALE_IMX_PLATFORM_IMX51
	default "imx53" if BR2_PACKAGE_FREESCALE_IMX_PLATFORM_IMX53
	default "imx6q" if BR2_PACKAGE_FREESCALE_IMX_PLATFORM_IMX6Q
	default "imx6q" if BR2_PACKAGE_FREESCALE_IMX_PLATFORM_IMX6S
	default "imx6q" if BR2_PACKAGE_FREESCALE_IMX_PLATFORM_IMX6UL
	default "imx7d" if BR2_PACKAGE_FREESCALE_IMX_PLATFORM_IMX7
	default "imx7d" if BR2_PACKAGE_FREESCALE_IMX_PLATFORM_IMX8M
	default "imx7d" if BR2_PACKAGE_FREESCALE_IMX_PLATFORM_IMX8MM
	default "imx7d" if BR2_PACKAGE_FREESCALE_IMX_PLATFORM_IMX8MN
	default "imx7d" if BR2_PACKAGE_FREESCALE_IMX_PLATFORM_IMX8MP
	default "imx7d" if BR2_PACKAGE_FREESCALE_IMX_PLATFORM_IMX8ULP

config BR2_PACKAGE_FIRMWARE_IMX_VPU_FW_NAME
	string
	default "imx27" if BR2_PACKAGE_FREESCALE_IMX_PLATFORM_IMX27ADS
	default "imx51" if BR2_PACKAGE_FREESCALE_IMX_PLATFORM_IMX51
	default "imx53" if BR2_PACKAGE_FREESCALE_IMX_PLATFORM_IMX53
	default "imx6"  if BR2_PACKAGE_FREESCALE_IMX_PLATFORM_IMX6Q
	default "imx8"  if BR2_PACKAGE_FREESCALE_IMX_PLATFORM_IMX8
	default "imx8"  if BR2_PACKAGE_FREESCALE_IMX_PLATFORM_IMX8X
	default "imx8"  if BR2_PACKAGE_FREESCALE_IMX_PLATFORM_IMX8DXL

config BR2_PACKAGE_FIRMWARE_IMX_NEEDS_HDMI_FW
	bool
	default y if BR2_PACKAGE_FREESCALE_IMX_PLATFORM_IMX8M

config BR2_PACKAGE_FIRMWARE_IMX_NEEDS_EASRC_FW
	bool
	default y if BR2_PACKAGE_FREESCALE_IMX_PLATFORM_IMX8MN

config BR2_PACKAGE_FIRMWARE_IMX_NEEDS_EPDC_FW
	bool
	default y if BR2_PACKAGE_FREESCALE_IMX_PLATFORM_IMX6Q
	default y if BR2_PACKAGE_FREESCALE_IMX_PLATFORM_IMX6S

config BR2_PACKAGE_FIRMWARE_IMX_NEEDS_DDR_FW
	bool
	default y if BR2_PACKAGE_FREESCALE_IMX_PLATFORM_IMX8M
	default y if BR2_PACKAGE_FREESCALE_IMX_PLATFORM_IMX8MM
	default y if BR2_PACKAGE_FREESCALE_IMX_PLATFORM_IMX8MN
	default y if BR2_PACKAGE_FREESCALE_IMX_PLATFORM_IMX8MP
	default y if BR2_PACKAGE_FREESCALE_IMX_PLATFORM_IMX91
	default y if BR2_PACKAGE_FREESCALE_IMX_PLATFORM_IMX93
	default y if BR2_PACKAGE_FREESCALE_IMX_PLATFORM_IMX94
	default y if BR2_PACKAGE_FREESCALE_IMX_PLATFORM_IMX95

if BR2_PACKAGE_FIRMWARE_IMX_NEEDS_DDR_FW

choice
	bool "DDR Firmware"
	help
	  Choose the DDR training binaries to be used depending on the
	  kind of memory that is available on the target board (DDR4,
	  LPDDR4, etc...).

config BR2_PACKAGE_FIRMWARE_IMX_LPDDR5_IMX95
	bool "LPDDR5"
	depends on BR2_PACKAGE_FREESCALE_IMX_PLATFORM_IMX95 || \
		BR2_PACKAGE_FREESCALE_IMX_PLATFORM_IMX94
	help
	  Use LPDDR5 binaries

config BR2_PACKAGE_FIRMWARE_IMX_LPDDR4X_IMX95
	bool "LPDDR4X"
	depends on BR2_PACKAGE_FREESCALE_IMX_PLATFORM_IMX95 || \
		BR2_PACKAGE_FREESCALE_IMX_PLATFORM_IMX94
	help
	  Use LPDDR4X binaries

config BR2_PACKAGE_FIRMWARE_IMX_LPDDR4_IMX93
	bool "LPDDR4"
	depends on BR2_PACKAGE_FREESCALE_IMX_PLATFORM_IMX93 || \
		BR2_PACKAGE_FREESCALE_IMX_PLATFORM_IMX91
	help
	  Use LPDDR4 binaries

config BR2_PACKAGE_FIRMWARE_IMX_LPDDR4_IMX8M
	bool "LPDDR4"
	depends on BR2_PACKAGE_FREESCALE_IMX_PLATFORM_IMX8M || \
		BR2_PACKAGE_FREESCALE_IMX_PLATFORM_IMX8MM || \
		BR2_PACKAGE_FREESCALE_IMX_PLATFORM_IMX8MN || \
		BR2_PACKAGE_FREESCALE_IMX_PLATFORM_IMX8MP
	help
	  Use LPDDR4 binaries

config BR2_PACKAGE_FIRMWARE_IMX_DDR4
	bool "DDR4"
	depends on BR2_PACKAGE_FREESCALE_IMX_PLATFORM_IMX8M || \
		BR2_PACKAGE_FREESCALE_IMX_PLATFORM_IMX8MM || \
		BR2_PACKAGE_FREESCALE_IMX_PLATFORM_IMX8MN || \
		BR2_PACKAGE_FREESCALE_IMX_PLATFORM_IMX8MP
	help
	  Use DDR4 binaries

config BR2_PACKAGE_FIRMWARE_IMX_DDR3
	bool "DDR3"
	depends on BR2_PACKAGE_FREESCALE_IMX_PLATFORM_IMX8M || \
		BR2_PACKAGE_FREESCALE_IMX_PLATFORM_IMX8MM || \
		BR2_PACKAGE_FREESCALE_IMX_PLATFORM_IMX8MN
	help
	  Use DDR3 binaries

endchoice

config BR2_PACKAGE_FIRMWARE_IMX_DDR_VERSION
	string "DDR/LPDDR firmware version"
	default "202409" if BR2_PACKAGE_FIRMWARE_IMX_LPDDR5_IMX95
	default "202409" if BR2_PACKAGE_FIRMWARE_IMX_LPDDR4X_IMX95
	default "202201" if BR2_PACKAGE_FIRMWARE_IMX_LPDDR4_IMX93
	default "202006" if BR2_PACKAGE_FIRMWARE_IMX_LPDDR4_IMX8M
	default "202006" if BR2_PACKAGE_FIRMWARE_IMX_DDR4 && BR2_PACKAGE_FREESCALE_IMX_PLATFORM_IMX8MP
	default "201810" if BR2_PACKAGE_FIRMWARE_IMX_DDR4
	default "201810" if BR2_PACKAGE_FIRMWARE_IMX_DDR3
	help
	  Use a specific version of the imx ddr binaries. Leaving this
	  field empty will select the default version.

config BR2_PACKAGE_FIRMWARE_IMX_IMEM_LEN
	hex "(LP)DDR IMEM padding length"
	default 0x8000
	help
	  The IMEM firmware will be padded to this length

config BR2_PACKAGE_FIRMWARE_IMX_DMEM_LEN
	hex "(LP)DDR DMEM padding length"
	default 0x4000
	help
	  The DMEM firmware will be padded to this length

endif # BR2_PACKAGE_FIRMWARE_IMX_NEEDS_DDR_FW

endif # BR2_PACKAGE_FIRMWARE_IMX
```

## package/freescale-imx/imx-gpu-mali/Config.in
```kconfig
comment "imx-gpu-mali needs a glibc toolchain"
	depends on BR2_aarch64
	depends on !BR2_TOOLCHAIN_USES_GLIBC

config BR2_PACKAGE_IMX_GPU_MALI
	bool "imx-gpu-mali"
	depends on BR2_aarch64
	depends on BR2_TOOLCHAIN_USES_GLIBC
	select BR2_PACKAGE_HAS_LIBEGL
	select BR2_PACKAGE_HAS_LIBGLES
	select BR2_PACKAGE_HAS_LIBOPENCL
	select BR2_PACKAGE_HAS_LIBGBM
	select BR2_PACKAGE_LIBGBM_HAS_FEATURE_DMA_BUF
	select BR2_PACKAGE_LIBGBM_HAS_FEATURE_FORMAT_MODIFIER_PLANE_COUNT
	select BR2_PACKAGE_LIBDRM
	help
	  Userspace libraries for Mali GPU on i.MX platforms

	  This library is provided by Freescale as-is and doesn't have
	  an upstream.

if BR2_PACKAGE_IMX_GPU_MALI

config BR2_PACKAGE_PROVIDES_LIBEGL
	default "imx-gpu-mali"

config BR2_PACKAGE_PROVIDES_LIBGLES
	default "imx-gpu-mali"

config BR2_PACKAGE_PROVIDES_LIBOPENCL
	default "imx-gpu-mali"

config BR2_PACKAGE_PROVIDES_LIBGBM
	default "imx-gpu-mali"

endif
```

## package/freescale-imx/imx-isp-vvcam/Config.in
```kconfig
config BR2_PACKAGE_IMX_ISP_VVCAM
	bool "imx-isp-vvcam"
	depends on BR2_LINUX_KERNEL
	depends on BR2_PACKAGE_FREESCALE_IMX_HAS_ISP
	select BR2_LINUX_NEEDS_MODULES
	help
	  Kernel loadable modules for the NXP i.MX8MP ISP (Image Signal
	  Processor), based on the Verisilicon vvcam driver stack: the
	  dewarp engine (dwe), ISP core, video buffer helper, image
	  sensor and lens/VCM focus drivers.

	  This module is only meant for the i.MX8MP NXP-BSP kernel.

	  https://github.com/nxp-imx/isp-vvcam
```

## package/freescale-imx/imx-oei/Config.in
```kconfig
config BR2_PACKAGE_IMX_OEI
    bool "imx-oei"
    help
        The Optional Executable Image (OEI) is an optional plugin loaded
        and executed by Cortex-M processor ROM on many NXP i.MX processors.
        The Cortex-M is the boot core, runs the boot ROM which loads the OEI,
        and then branches to the OEI. The OEI then configures some aspects of
        the hardware such as DDR config, init TCM ECC, etc.

if BR2_PACKAGE_IMX_OEI

config BR2_PACKAGE_IMX_OEI_BOARD_ID
    string "board-id"
    default "mx95lp5" if BR2_PACKAGE_FIRMWARE_IMX_LPDDR5_IMX95 && BR2_PACKAGE_FREESCALE_IMX_PLATFORM_IMX95
    default "mx95lp4" if BR2_PACKAGE_FIRMWARE_IMX_LPDDR4X_IMX95 && BR2_PACKAGE_FREESCALE_IMX_PLATFORM_IMX95
    default "mx943lp5-19" if BR2_PACKAGE_FIRMWARE_IMX_LPDDR5_IMX95 && BR2_PACKAGE_FREESCALE_IMX_PLATFORM_IMX94
    default "mx943lp4-19" if BR2_PACKAGE_FIRMWARE_IMX_LPDDR4X_IMX95 && BR2_PACKAGE_FREESCALE_IMX_PLATFORM_IMX94
    help
        Select the board ID for the OEI build. This must match the
        actual board being used, or the system may fail to boot.

config BR2_PACKAGE_IMX_OEI_DDR_CONFIG_FILE
    string "DDR configuration file"
    help
        Specify the DDR configuration file name for the OEI build.

endif # BR2_PACKAGE_IMX_OEI
```

## package/freescale-imx/imx-sm/Config.in
```kconfig
config BR2_PACKAGE_IMX_SM
    bool "imx-sm"
    help
        The i.MX System Manager (SM) firmware provides APIs to configure and
        manage various system-level features on i.MX processors, such as
        power management, clock configuration, and security settings.

config BR2_PACKAGE_IMX_SM_CONFIG
    string "i.MX SM Configuration"
    depends on BR2_PACKAGE_IMX_SM
    default "mx95evk"
    help
      Select the target board for which the i.MX System Manager firmware
      should be built. This setting determines the specific configuration
      and features included in the firmware binary.

      Available options:
      - mx95evk: i.MX95 Evaluation Kit
```

## package/libubootenv/Config.in
```kconfig
config BR2_PACKAGE_LIBUBOOTENV
	bool "libubootenv"
	help
	  libubootenv is a library that provides a hardware independent
	  way to access to U-Boot environment.

	  The package provides the fw_printenv / fw_setenv utilities,
	  new tools build from the library and not from U-Boot.

	  https://github.com/sbabic/libubootenv/

if BR2_PACKAGE_LIBUBOOTENV

config BR2_PACKAGE_LIBUBOOTENV_YAML_CONFIG
	bool "YAML configuration support"
	select BR2_PACKAGE_LIBYAML
	help
	  YAML configuration support for libubootenv.

endif
```

## package/python-cryptography/Config.in
```kconfig
config BR2_PACKAGE_PYTHON_CRYPTOGRAPHY
	bool "python-cryptography"
	depends on BR2_PACKAGE_HOST_RUSTC_TARGET_ARCH_SUPPORTS
	select BR2_PACKAGE_OPENSSL
	select BR2_PACKAGE_LIBOPENSSL_ENABLE_CHACHA if BR2_PACKAGE_LIBOPENSSL
	select BR2_PACKAGE_LIBOPENSSL_ENABLE_RC4 if BR2_PACKAGE_LIBOPENSSL
	select BR2_PACKAGE_PYTHON_CFFI # runtime
	help
	  cryptography is a package designed to expose cryptographic
	  primitives and recipes to Python developers.

	  https://cryptography.io

config BR2_PACKAGE_HOST_PYTHON_CRYPTOGRAPHY
	bool "host python-cryptography"
	depends on BR2_PACKAGE_HOST_RUSTC_TARGET_ARCH_SUPPORTS
	help
	  cryptography is a package designed to expose cryptographic
	  primitives and recipes to Python developers.
	  For the host.

	  https://cryptography.io
```

## package/python-uvicorn/Config.in
```kconfig
config BR2_PACKAGE_PYTHON_UVICORN
	bool "python-uvicorn"
	select BR2_PACKAGE_PYTHON_CLICK # runtime
	select BR2_PACKAGE_PYTHON_HTTPTOOLS # runtime
	select BR2_PACKAGE_PYTHON3_ZLIB # runtime
	select BR2_PACKAGE_PYTHON3_SSL # runtime
	help
	  The lightning-fast ASGI server.

	  https://uvicorn.dev/
```
